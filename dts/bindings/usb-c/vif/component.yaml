## dts/bindings/usb-c/vif/pcie-endpoint-list.yaml
```yaml
# Copyright 2022 The Chromium OS Authors
# SPDX-License-Identifier: Apache-2.0

description: |
    A list of collection of fields that characterize PCIe Endpoints within a router.

    This is based on VIF XML file schema of vif:PCIeEndpointListType in:
    https://compliance.usb.org/cv/VendorInfoFile/Schemas/Current/VendorInfoFile.xsd

compatible: "vif,pcie-endpoint-list"

include: base.yaml

properties:
    pcie-endpoint:
        type: phandles
        required: false
        description: |
            The fields represent the parameters for a single PCIe Endpoint. 
            Maximum number of phandle is 64
        
            Fields in this section shall be ignored by Testers if the Qualifying
            Product is not a USB4 Dock or USB4 Peripheral.
        
            Fields in this section shall be ignored by Testers if 
            USB4_Num_PCIe_DN_Adapters is set to 0.
```

## dts/bindings/usb-c/vif/pcie-endpoint.yaml
```yaml
# Copyright 2022 The Chromium OS Authors
# SPDX-License-Identifier: Apache-2.0

description: |
    A collection of fields that characterize a single PCIe Endpoint within a router

    This is based on VIF XML file schema of PCIeEndpoint in:
    https://compliance.usb.org/cv/VendorInfoFile/Schemas/Current/VendorInfoFile.xsd

compatible: "vif,pcie-endpoint"

include: base.yaml

properties:
    usb4-pcie-endpoint-vendor-id:
        type: int
        required: false
        description: |
            The Vendor ID of the PCIe endpoint. This value is assigned by PCIe 
            SIG. The valid values in the range 0h - FFFFh (0 - 65535).

    usb4-pcie-endpoint-device-id:
        type: int
        required: false
        description: |
            The Device ID of the PCIe endpoint. This value is assigned by the 
            vendor. The valid values in the range 0h - FFFFh (0 - 65535).

    usb4-pcie-endpoint-class-code:
        type: int
        required: false
        description: |
            The PCIe Class Code of the PCIe endpoint. The valid values in the 
            range 0 - FFFFFFh (0 - 16777215).
```

## dts/bindings/usb-c/vif/product.yaml
```yaml
# Copyright 2022 The Chromium OS Authors
# SPDX-License-Identifier: Apache-2.0

description: |
    It contains Fields or Field Group Lists that pertain to the Qualifying
    Product as a whole.

    This is based on VIF XML file schema of /VIF/Product in
    https://compliance.usb.org/cv/VendorInfoFile/Schemas/Current/VendorInfoFile.xsd

compatible: "vif,product"

include: base.yaml

properties:
    usb4-router-list:
        type: phandle
        required: false
        description: |
            A collection of fields that characterize a USB4 Router

    usb4-drom-vendor-id:
        type: int
        required: false
        description: |
            The Vendor ID of the Qualifying Product, as provided in the Product
            Descriptor Entry in USB4 DROM.

            If the Qualifying Product is not a USB4 Peripheral or a USB4 Hub,
            then this field shall be ignored by Testers.

            If /VIF/Certification_Type is set to 2 (Silicon), then this field
            shall be ignored by Testers.

    usb4-dock:
        type: boolean
        required: false
        description: |
            Is the Qualifying Product a Dock as specified in [USB4]?

            If the Qualifying Product is not a USB4 Hub, then this field shall
            be ignored by Testers.

    usb4-device-hifi-bi-tmu-mode-required:
        type: boolean
        required: false
        description: |
            Does the Qualifying Product require HiFi Bi-Directional TMU mode in
            order to be operational?

            If the Qualifying Product is not a USB4 Peripheral or a USB4 Dock,
            then this field shall be ignored by Testers.

    usb4-num-internal-host-controllers:
        type: int
        required: false
        description: |
            The number of Internal Host Controllers that the Qualifying Product
            contains.

            Valid values are in the range 0 - 4.

            If the Qualifying Product does not contain a USB4 Port, then this
            field shall be ignored by Testers.

            If the Qualifying Product is a USB4 Host or a USB4 Dock, then this
            field shall be greater than 0.

    usb4-num-pcie-dn-bridges:
        type: int
        required: false
        description: |
            The number of PCIe downstream bridges in the product that connect to
            a PCIe Adapter, a Native PCIe device or internal PCIe device.

            Valid values are in the range 0 - 63.

            This field shall be set to 0 unless the Qualifying Product has at
            least one USB4 Port on which USB4_PCIe_Tunneling_Supported is set
            to YES.

            If the Qualifying Product does not contain a USB4 Port, then this
            field shall be ignored by Testers.

    usb4-audio-supported:
        type: boolean
        required: false
        description: |
            Does the Product implement the USB Audio Class when operating over
            USB 3.2 or USB 2?

    usb4-hid-supported:
        type: boolean
        required: false
        description: |
            Does the Product implement the USB Human Interface Device (HID)
            Class when operating over USB 3.2 or USB 2?

    usb4-printer-supported:
        type: boolean
        required: false
        description: |
            Does the Product implement the USB Printer Class when operating over
            USB 3.2 or USB 2?

    usb4-mass-storage-supported:
        type: boolean
        required: false
        description: |
            Does the Product implement the USB Mass Storage Class when operating
            over USB 3.2 or USB 2?

    usb4-video-supported:
        type: boolean
        required: false
        description: |
            Does the Product implement the USB Video (UVC) Class when operating
            over USB 3.2 or USB 2?

    usb4-comms-networking-supported:
        type: boolean
        required: false
        description: |
            Does the Product implement the USB Comms/Networking Class when
            operating over USB 3.2 or USB 2?

    usb4-media-transfer-protocol-supported:
        type: boolean
        required: false
        description: |
            Does the Product implement the USB Media Transfer Protocol Class
            when operating over USB 3.2 or USB 2?

    usb4-smart-card-supported:
        type: boolean
        required: false
        description: |
            Does the Product implement the USB Smart Card Class when operating
            over USB 3.2 or USB 2?

    usb4-still-image-capture-supported:
        type: boolean
        required: false
        description: |
            Does the Product implement the USB Still Image Capture Class when
            operating over USB 3.2 or USB 2?

    usb4-monitor-device-supported:
        type: boolean
        required: false
        description: |
            Does the Product implement the USB Monitor Class when operating over
            USB 3.2 or USB 2?
```

## dts/bindings/usb-c/vif/usb4-router-list.yaml
```yaml
# Copyright 2022 The Chromium OS Authors
# SPDX-License-Identifier: Apache-2.0

description: |
    A list of collection of fields that characterize USB4 Routers.

    This is based on VIF XML file schema of vif:Usb4RouterListType in:
    https://compliance.usb.org/cv/VendorInfoFile/Schemas/Current/VendorInfoFile.xsd

compatible: "vif,usb4-router-list"

include: base.yaml

properties:
    usb4-router:
      type: phandles
      required: true
      description: |
          A collection of fields that characterize a USB4 Router
```

## dts/bindings/usb-c/vif/usb4-router.yaml
```yaml
# Copyright 2022 The Chromium OS Authors
# SPDX-License-Identifier: Apache-2.0

description: |
    A collection of fields that characterize a USB4 Router

    This is based on VIF XML file schema of Usb4Router in:
    https://compliance.usb.org/cv/VendorInfoFile/Schemas/Current/VendorInfoFile.xsd

compatible: "vif,usb4-router"

include: base.yaml

properties:
    usb4-router-id:
        type: int
        required: false
        description: |
            Index number assigned to uniquely identify Router within the product
            
            Valid values are in the range 0 - 15 and shall be less than the 
            number of Routers in the Qualifying Product.

    usb4-silicon-vid:
        type: int
        required: false
        description: |
            The Vendor Identification Number (VID) of the Vendor providing the 
            silicon for the Router.

            This value is assigned by USB-IF to the silicon vendor
          
            The valid values in the range 0h - FFFFh (0 - 65535).

    usb4-num-lane-adapters:
        type: int
        required: false
        description: |
            The total number of Lane Adapters on the Router. Valid values are in 
            the range 2 - 62.
            
            This field shall be greater than or equal to the number of USB4 
            Ports associated with this Router multiplied by 2.

    usb4-num-usb3-dn-adapters:
        type: int
        required: false
        description: |
            The number of Downstream USB3 Adapters on the Router. Valid values 
            are in the range 1 - 63.
            
            If the Qualifying Product is not a USB4 Host or a USB4 Hub, then 
            this field shall be ignored by Testers.

    usb4-num-dp-in-adapters:
        type: int
        required: false
        description: |
            The number of DisplayPort IN Adapters on the Router. Valid values 
            are in the range 0 - 63.
            
            If the Qualifying Product is a USB4 Host, then the sum of this field 
            over all routers shall be greater than 0.
            
            If the Qualifying Product is a USB4 Peripheral that supports DP 
            Tunneling (USB4_DP_Tunneling_Supported is set to YES on its USB4 UFP 
            and the USB4 UFP is associated with this Router), then at least one 
            of this field and USB4_Num_DP_OUT_Adapters shall be greater than 0.

    usb4-num-dp-out-adapters:
        type: int
        required: false
        description: |
            The number of DisplayPort OUT Adapters on the Router. Valid values 
            are in the range 0 - 63.
            
            USB4 Hubs shall not set this field to 0.
            
            If the Qualifying Product is a USB4 Peripheral that supports DP 
            Tunneling (USB4_DP_Tunneling_Supported is set to YES on its USB4 
            UFP) and the USB4 UFP is associated with this Router), then at least 
            one of this field and USB4_Num_DP_IN_Adapters shall be greater than 0.

    usb4-num-pcie-dn-adapters:
        type: int
        required: false
        description: |
            The number of PCIe Downstream Adapters on the Router. Valid values 
            are in the range 0 - 63.
            
            If USB4_PCIe_Tunneling_Supported is set to YES on a USB4 Port 
            associated with this Router, then this field shall be greater than 0

    usb4-tbt3-not-supported:
        type: int
        required: false
        description: |
            Indicates whether the product has one or more Thunderbolt 
            3-compatible Ports on this Router. Valid options are:
                0 - TBT3-Compatible
                1 - Not TBT3-Compatible
            
            This field shall be set to 0 (TBT3-Compatible) if 
            USB4_TBT3_Compatibility_Supported is set to YES on any USB4 Port 
            associated with this Router.
            
            This field shall be set to 1 (Not TBT3-Compatible) if 
            USB4_TBT3_Compatibility_Supported is not set to YES on any USB4 Port 
            associated with this Router.

    usb4-pcie-wake-supported:
        type: boolean
        required: false
        description: |
            Does the Qualifying Product support PCIe Wake? 
            
            This field shall be set to NO if USB4_Num_PCIe_DN_Adapters is set to 0

    usb4-usb3-wake-supported:
        type: boolean
        required: false
        description: |
            Does the Qualifying Product support USB3 Wake?
            
            If the Qualifying Product does not support USB3 tunneling on the 
            Router (USB4_USB3_Tunneling_Supported is set to NO on all USB4 Ports 
            associated with this Router), then this field shall be set to NO

    usb4-num-unused-adapters:
        type: int
        required: false
        description: |
            The number of Adapters in the Router that are not wired to a USB-C 
            Connector. Valid values are in the range 0 - 63.

    usb4-tbt3-vid:
        type: int
        required: false
        description: |
            The Thunderbolt 3 Vendor ID (VID), assigned by Intel. The valid 
            values in the range 0h - FFFFh (0 - 65535)
            
            If USB4_TBT3_Not_Supported is not set to 0 (TBT3-Compatible), then 
            this field shall be ignored by Testers.

    usb4-pcie-switch-vendor-id:
        type: int
        required: false
        description: |
            Vendor ID of PCIe switch connected to Router. This value is assigned 
            by PCIe SIG. The valid values in the range 0h - FFFFh (0 - 65535).
            
            This field shall be ignored by Testers if USB4_Num_PCIe_DN_Adapters 
            is set to 0.

    usb4-pcie-switch-device-id:
        type: int
        required: false
        description: |
            Device ID of PCIe switch connected to Router. This value is assigned 
            by the vendor. The valid values in the range 0h - FFFFh (0 - 65535).
            
            This field shall be ignored by Testers if USB4_Num_PCIe_DN_Adapters 
            is set to 0.

    usb4-num-pcie-endpoints:
        type: int
        required: false
        description: |
            The number of PCIe endpoints connected to Router. This includes 
            endpoints for the internal PCIe device and any other embedded PCIe 
            devices. Valid values are in the range 1 - 64.
            
            This field shall be ignored by Testers if the Qualifying Product is 
            not a USB4 Dock or USB4 Peripheral.
            
            This field shall be ignored by Testers if USB4_Num_PCIe_DN_Adapters 
            is set to 0.

    pcie-endpoint-list:
        type: phandle
        required: false
        description: |
            It represent the list of PCIe Endpoints
```

## dts/bindings/usb-c/vif/vif-app.yaml
```yaml
# Copyright 2022 The Chromium OS Authors
# SPDX-License-Identifier: Apache-2.0

description: |
    It describes the application that was used to generate the VIF

    This is based on VIF XML file schema of /VIF/VIF_App in
    https://compliance.usb.org/cv/VendorInfoFile/Schemas/Current/VendorInfoFile.xsd

compatible: "vif,vif-app"

include: base.yaml

properties:
    vendor:
        type: string
        required: true
        description: |
            The vendor of the application

    name:
        type: string
        required: true
        description: |
            The name of the application

    version:
        type: string
        required: true
        description: |
            The version number of the application
```
